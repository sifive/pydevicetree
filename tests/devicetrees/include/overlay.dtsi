// Copyright (c) 2019 SiFive Inc
// SPDX-License-Identifier: Apache-2.0
chosen {
	stdout-path = "/soc/uart@1000";
};

/ {
	cpus {
		cpu@1 {
			#size-cells = <0>;
			compatible = "riscv";
			reg = <1>;
		};
	};
};

&uart0 {
	status = "okay";
};
